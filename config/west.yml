## config/west.yml
```yaml
manifest:
  defaults:
    revision: v0.3
  remotes:
    - name: zmkfirmware
      url-base: https://github.com/zmkfirmware
    - name: indarli
      url-base: https://github.com/Indarli/zmk-config
  projects:
    - name: zmk
      remote: zmkfirmware
      import: app/west.yml
    - name: zmk-lily58
      remote: indarli
      revision: main
      path: boards/shields
  self:
    path: config
```
