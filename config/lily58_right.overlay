&kscan0 {
    col-gpios = <&gpio0 4 GPIO_ACTIVE_HIGH>,   // ваш новый пин для Col0
                <&gpio0 10 GPIO_ACTIVE_HIGH>,  // остальные скопируйте из lily58.dtsi
                <&gpio0 8 GPIO_ACTIVE_HIGH>,
                <&gpio0 7 GPIO_ACTIVE_HIGH>,
                <&gpio0 6 GPIO_ACTIVE_HIGH>,
                <&gpio0 5 GPIO_ACTIVE_HIGH>;
};
